## source_files/6.6.62/panel/Kconfig.inject
```kconfig
config DRM_PANEL_DSI_MT
	tristate "MOTIVO touchscreen panel"
	depends on OF
	depends on DRM_MIPI_DSI
	depends on BACKLIGHT_CLASS_DEVICE
	help
	  Say Y here if you want to enable support for the MOTIVO DSI
	  LCD modules. The panel has a 800x1280 resolution and uses
	  24 bit RGB per pixel. It provides a 4-lane MIPI DSI interface
	  to the host and has a built-in LED backlight.
```
